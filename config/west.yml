## config/west.yml
```yaml
manifest:
  remotes:
    - name: zmkfirmware
      url-base: https://github.com/zmkfirmware
    # Additional modules containing boards/shields/custom code can be listed here as well
    # See https://docs.zephyrproject.org/3.2.0/develop/west/manifest.html#projects
  projects:
    - name: zmk
      remote: zmkfirmware
      revision: main
      import: app/west.yml
  self:
    path: config
    
    
build:
  prj_conf: nice60.conf
  dts_overlays:
    - keyboards/nice60/nice60.dts
  keymap:
    - keyboards/nice60/keymaps/default/keymap.c

# Optionally specify the board you're targeting
boards:
  - nice60
```
